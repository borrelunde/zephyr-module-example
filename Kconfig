## Kconfig
```kconfig
config MODULE_EXAMPLE
	bool "Module example support"
	default n
	help
		This option enables module example.
```

## lib/Kconfig
```kconfig
menuconfig MODULE_EXAMPLE
	bool "Module example"
	help
	  Enable module example.
```

## west.yml
```yaml
manifest:
  version: 0.7

  self:
    # Where this repository should be cloned to.
    path: module-example
```
